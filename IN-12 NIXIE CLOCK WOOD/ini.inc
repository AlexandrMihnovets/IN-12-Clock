/*
 * ini.inc
 *
 *  Created: 21.03.2023 14:21:50
 *   Author: MikhnovetsA
 */ 

 ; Инициализация стэка
 ldi temp, high(RAMEND)
 out SPH, temp
 ldi temp, low(RAMEND)
 out SPL, temp

 ; Отключение компаратора
 ldi temp, (1<<ACD)
 out ACSR, temp

 ; Настройка портов ввода-вывода
 ldi temp, (1<<DDB7) | (1<<DDB6) | (1<<DDB0)	; T2, T1, T0 (единицы и десятки часов, единицы секунд соответственно)
 out DDRB, temp

 ldi temp, (1<<DDD7) | (1<<DDD6) | (1<<DDD5) | (1<<DDD1) | (1<<DDD0)	; T5, T4, T3 (Десятки секунд, единицы и десятки минут соответственно)
 out DDRD, temp															; SDA и SCL для инициализации DS1307, потом SDA будет меняться для чтения из DS1307

 ldi temp, (1<<DDC3) | (1<<DDC2) | (1<<DDC1) | (1<<DDC0)	; A, D, B, C дешифратора (D -старший бит 4-хбитного значения)
 out DDRC, temp

 ; Настройка АЦП

 ; Настройка внешнего прерывания на INT0 от часов DS1307
 ldi temp, (1<<ISC01)	; Прерывание по спаду
 out MCUCR, temp
 ldi temp, (1<<INT0)	; на INT0
 out GICR, temp

 ; Настройка Таймера0

 ; Настройка Таймера1
 ldi temp, high(62499)
 out OCR1AH, temp
 ldi temp, low(62499)
 out OCR1AL, temp	; Запись в регистр сравнения для прерывания раз в секунду

 ;ldi temp, (1<<OCIE1A)
 ;out TIMSK, temp	; В этот регистр писать в одном месте, иначе что-то сбросится
 
 ldi temp, (1<<CS11) | (1<<WGM12)	; CS12 must be
 out TCCR1B, temp	; Предделитель 256 (частота на входе счётчика 62500), и сброс счётчика при совпадении
 
 ; Настройка Таймера2, он служит для динамического переключения индикаторов и регулировки их яркости
 ldi temp, (1<<CS22); Предделитель таймера 64. Тогда частота переключения 6 ламп составит 81 Гц
 out TCCR2, temp

 clr temp
 out TCNT2, temp	; Сброс счётного регистра

 ldi temp, 255
 out OCR2, temp		; Установка регистра совпадения (максимальная яркость индикаторов)

 ldi temp, (1<<OCIE2) | (1<<TOIE2) | (1<<OCIE1A)	; Разрешение прерываний по совпадению и по переполнению Таймера2, и по совпадению А Таймера 1
 out TIMSK, temp