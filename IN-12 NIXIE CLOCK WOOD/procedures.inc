/*
 * procedures.inc
 *
 *  Created: 21.03.2023 14:20:09
 *   Author: MikhnovetsA
 */ 

 ; Перед вызовом процедуры необходимо в temp поместить искомое число от 0 до 99 в HEX формате
 ; На выходе будет в temp1 старший разряд, в temp младший. Оба в распакованном виде
 bin2bcd8:	; Процедура преобразования HEX значения в распакованный BCD формат
	clr temp1			; Старший BCD (десятки)
 bBCD8_1:
	subi temp, 10		; В temp значение часов. В цикле вычитаем 10, пока не вылезет заём. Тем самым считаем кол-во десятков
	brcs bBCD8_2		; Если стало меньше нуля, заканчиваем
	inc temp1			; Если по прежнему больше нуля, прибавляем к temp1
	rjmp bBCD8_1
 bBCD8_2:
	subi temp, -10		; Компенсируем переход через ноль, младший BCD (единицы)
 ret
 ; Чтобы получить в temp упакованный BCD, нужно сделать swap temp1
 ;														or temp, temp1. 
 ; Всё

Find_num_in_flash_and_set_to_PORTC:
	add ZL, temp
	lpm temp, Z
	out PORTC, temp
ret

Save_BCD_to_SRAM:
	st Y+, temp					; Сохраняем единицы секунд в ОЗУ
	st Y+, temp1				; Сохраняем десятки секунд в ОЗУ
	swap temp1					; Меняем местами тетрады, чтобы занять старшие биты в temp1
	or temp, temp1				; Склеиваем тетрады в упакованный BCD для секунд
	st Y, temp					; Сохраняем в ОЗУ упакованные секунды
ret